#define BLINKER_WIFI
#define BLINKER_MIOT_SENSOR

#include <Blinker.h>
#include "U8g2lib.h"
#include <Wire.h>

#define SCL D3
#define SDA D4

static const unsigned char bmp1[] U8X8_PROGMEM = {
0x00,0x00,0xFE,0x01,0x00,0x00,0x00,0x00,0x00,0x00,0xFE,0x07,0x00,0xFC,0x01,0x00,0x00,0x00,0xFE,0x1F,0x00,0xFC,0x01,0x00,0x00,0x00,0xFE,0x3F,0x00,0xFC,0x01,0x00,
0x00,0x00,0xFE,0x7F,0x00,0xFC,0x01,0x00,0x00,0x00,0xFE,0xFF,0x03,0xFC,0x01,0x00,0x00,0x00,0xFE,0xFF,0x03,0xFC,0x01,0x00,0x00,0x00,0x7E,0xFE,0x07,0xFC,0x01,0x00,
0x00,0x00,0x7E,0xFC,0x0F,0xFC,0x01,0x00,0x00,0x00,0x7E,0xF8,0x3F,0xFC,0x01,0x00,0x00,0x00,0x7E,0xF0,0x7F,0xFC,0x01,0x00,0x00,0x00,0x7E,0xD0,0xFF,0xFC,0x01,0x00,
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0x00,0x00,0xF8,0xFF,0x07,0x00,0x00,0x00,0x00,0x00,0xF8,0xFF,0x0B,0x00,0x00,0x00,0x00,0x00,0xE0,0xFF,0x07,0x00,0x00,0x00,0x00,0x00,0xC0,0xFF,0x00,0x00,0x00,0x00,
/* (64 X 64 )*/
};

U8G2_SSD1306_128X64_NONAME_1_SW_I2C u8g2(U8G2_R0, /* clock=*/ SCL, /* data=*/ SDA, /* reset=*/ U8X8_PIN_NONE);   

StaticJsonDocument<1024> doc;
String ABCD = "ABCDD";
char auth[] = "14a1a2cb5cc1";
char ssid[] = "MSI";
char pswd[] = "1234567890";

String API = "http://mcapi.us/server/status?ip=servermc.ltd&port=25565";
String resBuff;

int max_number,now,duration;
int rssi;

bool result;

// 新建组件对象
BlinkerButton Button1("btn-abc");
BlinkerNumber Number1("num-now");
BlinkerNumber Number2("num-rssi");
BlinkerText Text1("text-player");

void getFollower(String url);

// 按下按键即会执行该函数
void button1_callback(const String & state){
    BLINKER_LOG("get button state: ", state);
    digitalWrite(LED_BUILTIN, !digitalRead(LED_BUILTIN));
}

// 如果未绑定的组件被触发，则会执行其中内容
void dataRead(const String & data){
    BLINKER_LOG("Blinker readString: ", data);
    Blinker.vibrate();
    uint32_t BlinkerTime = millis();
    Blinker.print("millis", BlinkerTime);
}

void dataStorage(){
    Blinker.dataStorage("now", now);
}

void miotQuery(int32_t queryCode)
{
    BLINKER_LOG("MIOT Query codes: ", queryCode);

    switch (queryCode)
    {
        case BLINKER_CMD_QUERY_ALL_NUMBER :
            BLINKER_LOG("MIOT Query All");
            BlinkerMIOT.temp(now);
            BlinkerMIOT.humi(now);
            BlinkerMIOT.pm25(now);
            BlinkerMIOT.co2(now);
            BlinkerMIOT.print();
            break;
        default :
            BlinkerMIOT.temp(now);
            BlinkerMIOT.humi(now);
            BlinkerMIOT.pm25(now);
            BlinkerMIOT.co2(now);
            BlinkerMIOT.print();
            break;
    }
}

void WIFI_rssi(){
  rssi = WiFi.RSSI();Number2.print(rssi);
  Serial.print("rssi:");Serial.println(rssi);
  if((rssi >= -19)&&(rssi <= 0))Number2.icon("fad fa-signal-alt");
  else if((rssi <= -20)&&(rssi >= -39))Number2.icon("fad fa-signal-alt-3");
  else if((rssi <= -40)&&(rssi >= -79))Number2.icon("fad fa-signal-alt-2");
  else if((rssi <= -80)&&(rssi >= -100))Number2.icon("fad fa-signal-alt-1");
  else Number2.icon("fad fa-signal-alt-slash");
}

void deal_string(String zfc){//初步处理json数据
  int size_zfc = zfc.length();//计算原字符串长度
  int place = zfc.indexOf("players");//获取“players”的位置
  //Serial.print("size:");Serial.println(size_zfc);
  //Serial.print("place:");Serial.println(place);
  String temp_zfc;
  temp_zfc = zfc.substring(place - 1);//删除原字符串前n-1位
  temp_zfc = "{" + temp_zfc;//左边补上{
  resBuff = temp_zfc;
  BLINKER_LOG("resBuff: ", resBuff);
}

void setup(){
    // 初始化串口
    Serial.begin(115200);
    BLINKER_DEBUG.stream(Serial);
    BLINKER_DEBUG.debugAll();
    
    // 初始化有LED的IO
    pinMode(LED_BUILTIN, OUTPUT);
    digitalWrite(LED_BUILTIN, HIGH);
    // 初始化blinker
    Blinker.begin(auth, ssid, pswd);
    Blinker.attachData(dataRead);
    BlinkerMIOT.attachQuery(miotQuery);
    Blinker.attachDataStorage(dataStorage);
    
    Button1.attach(button1_callback);

    u8g2.begin();
    
    while(result != 1){
      result = Blinker.connected();
      u8g2.firstPage();
      do {
        u8g2.setFont(u8g2_font_ncenB14_tr);
        u8g2.drawXBMP(32,0, 64, 64, bmp1);
      } while ( u8g2.nextPage() );
    Blinker.delay(10);
    }
    u8g2.clearBuffer();
    u8g2.clearDisplay();
}

void loop() {
  Blinker.run();
  getFollower(API);
  WIFI_rssi();
  Blinker.delay(1000);
}

void getFollower(String url){
  String temp_char;
  
  HTTPClient http;
  client.setTimeout(10000);
  
  http.begin(url);

  int httpCode = http.GET();
  Serial.printf("[HTTP] GET... code: %d\n", httpCode);

  if (httpCode == 200)
  {
    Serial.println("Get OK");
    resBuff = http.getString();
    deal_string(resBuff);
    Serial.println(resBuff);
    BLINKER_LOG("resBuff: ", resBuff);
    DeserializationError error = deserializeJson(doc, resBuff);

    max_number = doc["players"]["max"];
    Serial.print("max:");
    Serial.println(max_number);

    now = doc["players"]["now"];
    Serial.print("now:");
    Serial.println(now);
    Number1.print(now);

    duration = doc["duration"];
    Serial.print("duration:");
    Serial.println(duration);

    const char* player_temp;
    
    u8g2.clearBuffer();
    u8g2.firstPage();
    u8g2.setFontDirection(1);
    if(duration == 0)
    do {
        now = 0;
        u8g2.setFont(u8g2_font_t0_18_tf);
        u8g2.drawStr(110 , 12 , "McZoo");
        u8g2.drawStr(70 , 9 , "error");
        u8g2.sendBuffer();  
      }while ( u8g2.nextPage() );
     else{
    if(now == 0)
      do {
        u8g2.setFont(u8g2_font_t0_18_tf);
        u8g2.drawStr(110 , 12 , "McZoo");
        u8g2.drawStr(70 , 7 , "nobody");
        u8g2.sendBuffer();  
      }while ( u8g2.nextPage() );
    else
      do {
        u8g2.setFont(u8g2_font_t0_18_tf);
        u8g2.drawStr(110 , 12 , "McZoo");
        for(int16_t i = 0;i < now;i++){
        player_temp = doc["players"]["sample"][i]["name"];
        //Serial.print("player");Serial.print(i);Serial.print(":");Serial.println(player_temp);
        Text1.print("players:", player_temp);
        u8g2.setFont(u8g2_font_t0_13_tf);
        u8g2.drawStr((9-i)*11 , 2 , player_temp);}
        BLINKER_LOG("player: ", player_temp);
        u8g2.sendBuffer();  
      }while ( u8g2.nextPage() );}
  }
  else{
    Serial.println("[HTTP] GET... failed");
  }
  http.end();
}
